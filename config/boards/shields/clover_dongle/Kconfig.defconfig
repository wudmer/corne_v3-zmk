## config/boards/shields/clover_dongle/Kconfig.defconfig
```kconfig
# SPDX-License-Identifier: MIT

if SHIELD_CLOVER_DONGLE

# Max 16 characters
config ZMK_KEYBOARD_NAME
	default "Clover Dongle"

config ZMK_SPLIT
	default y

config ZMK_SPLIT_ROLE_CENTRAL
	default y

# Two peripherals: left half + right half
config ZMK_SPLIT_BLE_CENTRAL_PERIPHERALS
	default 2

# Peripherals (2) + desired BT profiles (5)
config BT_MAX_CONN
	default 7

config BT_MAX_PAIRED
	default 7

endif
```

## config/boards/shields/clover_dongle/Kconfig.shield
```kconfig
# SPDX-License-Identifier: MIT

config SHIELD_CLOVER_DONGLE
	def_bool $(shields_list_contains,clover_dongle)
```

## config/boards/shields/corne/Kconfig.defconfig
```kconfig
if SHIELD_CORNE_LEFT

config ZMK_KEYBOARD_NAME
	default "Corne"

# Use a plain default (not the `select`-based ZMK_SPLIT_BLE_ROLE_CENTRAL) so the
# dongle build can override this to `n` via cmake-args and make the left half a
# peripheral. A `select` cannot be overridden on the command line; a default can.
config ZMK_SPLIT_ROLE_CENTRAL
	default y

endif

if SHIELD_CORNE_LEFT || SHIELD_CORNE_RIGHT

config ZMK_SPLIT
	default y

endif
if SHIELD_CORNE_LEFT || SHIELD_CORNE_RIGHT

config ZMK_SPLIT
    default y

if ZMK_DISPLAY

config I2C
    default y

config SSD1306
    default y

endif # ZMK_DISPLAY

if LVGL

config LV_Z_VDB_SIZE
    default 64

config LV_DPI_DEF
    default 148

config LV_Z_BITS_PER_PIXEL
    default 1

choice LV_COLOR_DEPTH
    default LV_COLOR_DEPTH_1
endchoice

endif # LVGL

endif
```
